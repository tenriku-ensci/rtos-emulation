## rt-thread/bsp/qemu-cortex-m7-test/drivers/Kconfig
```kconfig
menu "Hardware Drivers Config"

config SOC_MPS2_AN500
    bool
    select ARCH_ARM_CORTEX_M7
    select RT_USING_COMPONENTS_INIT
    select RT_USING_USER_MAIN
    default y

menu "Onboard Peripheral Drivers"
    menuconfig BSP_USING_UART
        bool "Enable UART"
        default y
        select RT_USING_SERIAL
        if BSP_USING_UART
            config BSP_USING_UART0
                bool "Enable UART0 (Debugger)"
                default y
        endif
endmenu

endmenu
```
